define symbol __ICFEDIT_intvec_start__          = 0x20120000;

define symbol __ICFEDIT_region_SRAM2_start__    = 0x20120100;
define symbol __ICFEDIT_region_SRAM2_end__      = 0x2013FFFF;

define symbol __ICFEDIT_size_cstack__           = 1024;
define symbol __ICFEDIT_size_heap__             = 0;

define memory mem with size                     = 4G;

define region SRAM2_region                      = mem:[ from __ICFEDIT_region_SRAM2_start__ to __ICFEDIT_region_SRAM2_end__ ];

define block  CSTACK                            with alignment = 8, size = __ICFEDIT_size_cstack__    { };
define block  HEAP                              with alignment = 8, size = __ICFEDIT_size_heap__      { };

initialize by copy    { readwrite };
do not initialize     { section .noinit };

place at address      mem:__ICFEDIT_intvec_start__    { section .intvec };
place at start of     SRAM2_region                    { block RamTop with fixed order { readonly, section LOWEND } };
place at end of       SRAM2_region                    { block RamBottom with fixed order { section HIGHSTART, readwrite, section .noinit, block CSTACK, block HEAP } };
